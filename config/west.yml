## config/west.yml
```yaml
manifest:
  remotes:
    - name: zmkfirmware
      url-base: https://github.com/zmkfirmware
    - name: urob
      url-base: https://github.com/urob
    - name: cay
      url-base: https://github.com/caksoylar
    - name: pete
      url-base: https://github.com/petejohanson
    - name: badjeff
      url-base: https://github.com/badjeff

  projects:
    - name: zmk
      remote: zmkfirmware
      revision: main
      import: app/west.yml
    - name: blank-slate-zmk-module
      remote: pete
      revision: main
    - name: zmk-behavior-key-tempo
      remote: badjeff
      revision: main
  self:
    path: config
```
